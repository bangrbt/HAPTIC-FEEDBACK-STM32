#include "ssd1306_i2c.h"
#include <stdio.h> // Dùng cho các hàm xử lý chuỗi nếu cần

// Khai báo hàm Delay (extern) nếu bạn đã viết nó trong main.c
extern void Delay_ms(volatile uint32_t ms);
const uint8_t Font5x8[][5] = {
    {0x00,0x00,0x00,0x00,0x00}, {0x00,0x00,0x5F,0x00,0x00}, // Space, !
    {0x00,0x07,0x00,0x07,0x00}, {0x14,0x7F,0x14,0x7F,0x14}, // ", #
    {0x24,0x2A,0x7F,0x2A,0x12}, {0x23,0x13,0x08,0x64,0x62}, // $, %
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    {0x08,0x04,0x08,0x10,0x08}  // ~
};

// ================= CẤU HÌNH I2C1 (PB6, PB7) =================
void I2C1_Init(void) {
    // 1. Bật Clock GPIOB và I2C1
    RCC->AHB1ENR |= RCC_AHB1ENR_GPIOBEN;
    RCC->APB1ENR |= RCC_APB1ENR_I2C1EN;

    // 2. Cấu hình PB6, PB7 là Alternate Function, Open-Drain, Pull-up, High Speed
    GPIOB->MODER  &= ~((3UL << 12) | (3UL << 14));
    GPIOB->MODER  |=  ((2UL << 12) | (2UL << 14)); // AF Mode
    GPIOB->OTYPER |=  ((1UL << 6)  | (1UL << 7));  // Open Drain (Rất quan trọng cho I2C)
    GPIOB->PUPDR  &= ~((3UL << 12) | (3UL << 14));
    GPIOB->PUPDR  |=  ((1UL << 12) | (1UL << 14)); // Pull-up
    GPIOB->OSPEEDR|=  ((3UL << 12) | (3UL << 14)); // High Speed

    GPIOB->AFR[0] &= ~((0xFUL << 24) | (0xFUL << 28));
    GPIOB->AFR[0] |=  ((4UL << 24) | (4UL << 28));   // Gán AF4 (I2C1)

    // 3. Reset I2C
    I2C1->CR1 |= I2C_CR1_SWRST;
    I2C1->CR1 &= ~I2C_CR1_SWRST;

    // 4. Cấu hình tần số I2C1 (Giả sử APB1 chạy 16MHz mặc định)
    I2C1->CR2 = 16;
    // Tính CCR cho Standard Mode 100kHz: CCR = 16MHz / (2 * 100kHz) = 80
    I2C1->CCR = 80;
    I2C1->TRISE = 17; // (16 + 1)

    // 5. Bật I2C1
    I2C1->CR1 |= I2C_CR1_PE;
}

void I2C_Reset(void) {
    I2C1->CR1 |= I2C_CR1_SWRST;
    for (volatile int i = 0; i < 1000; i++) {}
    I2C1->CR1 &= ~I2C_CR1_SWRST;
    I2C1_Init();
}

// Hàm gửi 1 byte qua I2C kèm cơ chế chống treo cứng (Timeout & Auto Reset)
void I2C_WriteReg(uint8_t dev_addr, uint8_t control_byte, uint8_t data) {
    volatile uint32_t timeout;
    const uint32_t TIMEOUT_VAL = 2000; // Ngưỡng timeout đủ ngắn để không giật lag

    // 1. Gửi START
    I2C1->CR1 |= I2C_CR1_START;
    timeout = TIMEOUT_VAL;
    while (!(I2C1->SR1 & I2C_SR1_SB)) {
        if (--timeout == 0) { I2C_Reset(); return; }
    }

    // 2. Gửi địa chỉ thiết bị (Write)
    I2C1->DR = dev_addr;
    timeout = TIMEOUT_VAL;
    while (!(I2C1->SR1 & I2C_SR1_ADDR)) {
        if (--timeout == 0) { I2C_Reset(); return; }
    }
    (void)I2C1->SR1; (void)I2C1->SR2; // Xóa cờ ADDR

    // 3. Gửi Control Byte (0x00 cho Command, 0x40 cho Data)
    I2C1->DR = control_byte;
    timeout = TIMEOUT_VAL;
    while (!(I2C1->SR1 & I2C_SR1_TXE)) {
        if (--timeout == 0) { I2C_Reset(); return; }
    }

    // 4. Gửi dữ liệu
    I2C1->DR = data;
    timeout = TIMEOUT_VAL;
    while (!(I2C1->SR1 & I2C_SR1_TXE)) {
        if (--timeout == 0) { I2C_Reset(); return; }
    }

    // 5. Gửi STOP
    I2C1->CR1 |= I2C_CR1_STOP;
}

// ================= CÁC LỆNH ĐIỀU KHIỂN OLED SSD1306 =================
#define OLED_ADDR 0x78 // Địa chỉ I2C của màn hình (Có thể là 0x3C << 1)

void OLED_Cmd(uint8_t cmd) {
    I2C_WriteReg(OLED_ADDR, 0x00, cmd);
}

void OLED_Data(uint8_t data) {
    I2C_WriteReg(OLED_ADDR, 0x40, data);
}

// Thiết lập con trỏ hiển thị (Page: 0-7, Column: 0-127)
void OLED_SetCursor(uint8_t page, uint8_t col) {
    OLED_Cmd(0xB0 | page);                  // Set Page
    OLED_Cmd(0x00 | (col & 0x0F));          // Set cột thấp (Lower Column)
    OLED_Cmd(0x10 | ((col >> 4) & 0x0F));   // Set cột cao (Higher Column)
}

// Xóa toàn bộ màn hình
void OLED_Clear(void) {
    for (uint8_t page = 0; page < 8; page++) {
        OLED_SetCursor(page, 0);
        for (uint8_t col = 0; col < 128; col++) {
            OLED_Data(0x00);
        }
    }
}

// In một ký tự
void OLED_PrintChar(char c) {
    if (c < 32 || c > 126) c = 32; // Chỉ in ký tự hỗ trợ
    for (uint8_t i = 0; i < 5; i++) {
        OLED_Data(Font5x8[c - 32][i]);
    }
    OLED_Data(0x00); // Khoảng trống giữa các chữ
}

// In một chuỗi tại vị trí cụ thể
void OLED_PrintString(uint8_t page, uint8_t col, char* str) {
    OLED_SetCursor(page, col);
    while (*str) {
        OLED_PrintChar(*str++);
    }
}

// Khởi tạo màn hình
void OLED_Init(void) {
    Delay_ms(100); // Chờ OLED cấp nguồn ổn định

    OLED_Cmd(0xAE); // Tắt màn hình (Display OFF)
    OLED_Cmd(0x20); OLED_Cmd(0x02); // Set Memory Addressing Mode (Page Addressing)
    OLED_Cmd(0xB0); // Set Page Start Address for Page Addressing Mode
    OLED_Cmd(0xC8); // Set COM Output Scan Direction
    OLED_Cmd(0x00); // Set low column address
    OLED_Cmd(0x10); // Set high column address
    OLED_Cmd(0x40); // Set start line address
    OLED_Cmd(0x81); OLED_Cmd(0xFF); // Set contrast control register
    OLED_Cmd(0xA1); // Set segment re-map
    OLED_Cmd(0xA6); // Set normal display (0xA7 là invert)
    OLED_Cmd(0xA8); OLED_Cmd(0x3F); // Set multiplex ratio(1 to 64)
    OLED_Cmd(0xA4); // Đưa dữ liệu từ RAM ra màn hình
    OLED_Cmd(0xD3); OLED_Cmd(0x00); // Set display offset
    OLED_Cmd(0xD5); OLED_Cmd(0xF0); // Set display clock divide ratio/oscillator frequency
    OLED_Cmd(0xD9); OLED_Cmd(0x22); // Set pre-charge period
    OLED_Cmd(0xDA); OLED_Cmd(0x12); // Set com pins hardware configuration
    OLED_Cmd(0xDB); OLED_Cmd(0x20); // Set vcomh
    OLED_Cmd(0x8D); OLED_Cmd(0x14); // Bật Charge Pump (Rất quan trọng, không có màn sẽ đen)
    OLED_Cmd(0xAF); // Bật màn hình (Display ON)

    OLED_Clear();
}
